## boards/jzf/cornix/board.yml
```yaml
boards:
  - name: cornix_left
    vendor: jzf
    socs:
      - name: nrf52840
        variants:
          - name: zmk
    revision:
      format: major.minor.patch
      default: 3.0.0
      revisions:
        - name: 1.0.0
        - name: 1.1.0
        - name: 3.0.0
  - name: cornix_right
    vendor: jzf
    socs:
      - name: nrf52840
        variants:
          - name: zmk
    revision:
      format: major.minor.patch
      default: 3.0.0
      revisions:
        - name: 1.0.0
        - name: 1.1.0
        - name: 3.0.0
  - name: cornix_ph_left
    vendor: jzf
    socs:
      - name: nrf52840
        variants:
          - name: zmk
    revision:
      format: major.minor.patch
      default: 3.0.0
      revisions:
        - name: 1.0.0
        - name: 1.1.0
        - name: 3.0.0
```

## boards/shields/cornix_dongle_adapter/Kconfig.defconfig
```kconfig
if SHIELD_CORNIX_DONGLE_ADAPTER

config ZMK_KEYBOARD_NAME
    default "Cornix Dongle"

config ZMK_USB
    default y

config ZMK_BLE
    default y

config ZMK_SPLIT
    default y

config ZMK_SPLIT_ROLE_CENTRAL
    default y

config ZMK_SPLIT_BLE_CENTRAL_BATTERY_LEVEL_FETCHING
    default y

config ZMK_SPLIT_BLE_CENTRAL_BATTERY_LEVEL_PROXY
    default y

config ZMK_SPLIT_BLE_CENTRAL_PERIPHERALS
    default 2

endif # SHIELD_CORNIX_DONGLE_ADAPTER

#vim: set ft=kconfig:
```

## config/west.yml
```yaml
manifest:
  remotes:
    - name: zmkfirmware
      url-base: https://github.com/zmkfirmware
    - name: hitsmaxft
      url-base: https://github.com/hitsmaxft
    - name: englmaxi
      url-base: https://github.com/englmaxi
    - name: urob
      url-base: https://github.com/urob
    - name: janpfischer
      url-base: https://github.com/janpfischer
    - name: cormoran
      url-base: https://github.com/cormoran
  projects:
    - name: zmk
      remote: zmkfirmware
      revision: main
      clone-depth: 1
      import:
        file: app/west.yml
    - name: zmk-helpers
      remote: urob
      revision: main
      clone-depth: 1
    #- name: zmk-rgbled-widget
    #  remote: hitsmaxft
    #  revision: main
    #  clone-depth: 1
    - name: zmk-dongle-display
      remote: englmaxi
      revision: main
      clone-depth: 1
    # DYA Studio extensions. ZMK Studio remains enabled as the shared RPC transport.
    - name: zmk-module-ble-management
      remote: cormoran
      revision: main
      clone-depth: 1
    - name: zmk-module-battery-history
      remote: cormoran
      revision: main
      clone-depth: 1
    - name: zmk-module-settings-rpc
      remote: cormoran
      revision: main
      clone-depth: 1
    - name: zmk-module-runtime-input-processor
      remote: cormoran
      revision: main
      clone-depth: 1
    #- name: zmk-dongle-screen
    #  remote: janpfischer
    #  revision: main
    #  clone-depth: 1
  self:
    path: config
```
