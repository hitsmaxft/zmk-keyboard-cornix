## boards/arm/cornix/Kconfig.defconfig
```kconfig
# Electronut Labs Papyr board configuration

# Copyright (c) 2020 The ZMK Contributors
# SPDX-License-Identifier: MIT


if BOARD_CORNIX

config BOARD
    default "cornix"

endif # BOARD_CORNIX

## Main device (left side)
if BOARD_CORNIX_LEFT || BOARD_CORNIX_DONGLE

config ZMK_KEYBOARD_NAME
	default "Cornix"

if USB

config USB_NRFX
    default y

config USB_DEVICE_STACK
    default y

endif # USB

config ZMK_SPLIT_ROLE_CENTRAL
    default y

config ZMK_SPLIT_BLE_ROLE_CENTRAL
	default y

config ZMK_SPLIT_BLE_CENTRAL_BATTERY_LEVEL_FETCHING
	default y

config ZMK_SPLIT_BLE_CENTRAL_BATTERY_LEVEL_PROXY
	default y

endif ## Main device (left side)

## Peripheral device (right side)
if BOARD_CORNIX_RIGHT || BOARD_CORNIX_PH_LEFT

config ZMK_SPLIT_ROLE_CENTRAL
    default n

config ZMK_SPLIT_BLE_ROLE_CENTRAL
	default n

# Add keyboard debouncing
config ZMK_KSCAN_DEBOUNCE_PRESS_MS
    default 5
config ZMK_KSCAN_DEBOUNCE_RELEASE_MS
    default 5

endif ## Peripheral device (right side)

## For both sides
if BOARD_CORNIX_LEFT  || BOARD_CORNIX_DONGLE || BOARD_CORNIX_PH_LEFT || BOARD_CORNIX_RIGHT


config BT_CTLR
    default BT

config BOARD_CORNIX_CHARGER
    default y

config ZMK_SPLIT
	default y

config ZMK_BLE
	default y

## disable rgb by default
config WS2812_STRIP
	default n
config ZMK_RGB_UNDERGLOW
	default n
config ZMK_RGB_UNDERGLOW_EXT_POWER
	default n

endif ## For both sides


# vim: set ft=kconfig:
```

## boards/shields/cornix_indicator/Kconfig.shield
```kconfig
config SHIELD_CORNIX_INDICATOR
	def_bool $(shields_list_contains, cornix_indicator)
```
