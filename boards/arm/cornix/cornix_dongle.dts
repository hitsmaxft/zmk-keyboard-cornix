/*
 * Copyright (c) 2020 Pete Johanson
 *
 * SPDX-License-Identifier: MIT
 */
/dts-v1/;

#include <nordic/nrf52840_qiaa.dtsi>
#include "nrf_e73.dtsi"
#include <dt-bindings/led/led.h>
#include <dt-bindings/zmk/matrix_transform.h>
#include "cornix_dongle_common.dtsi"
// vim: set ft=dts :
